## package/busybox/Config.in
```kconfig
if PACKAGE_busybox

config BUSYBOX_CONFIG_NOMMU
	bool
	depends NOMMU
	default y if NOMMU
	deselect BUSYBOX_CONFIG_ASH
	deselect BUSYBOX_CONFIG_FEATURE_SH_IS_ASH
	deselect BUSYBOX_CONFIG_LOCK

config busybox_revision
	string
	prompt "Set busybox revision, 1_20_1, 1.31.1"
	default "1_20_1"

config CONFIG_BUSYBOX_CONFIG_FEATURE_SH_IS_HUSH
	bool
	default y if NOMMU
	default n if !NOMMU

config BUSYBOX_CONFIG_HUSH
	bool
	default y if NOMMU
	default n if !NOMMU

source "package/busybox/config/Config.in"

endif
```
